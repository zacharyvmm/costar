## crates/sim-zephyr-port/zephyr_integration/arch/sim/Kconfig
```kconfig
# Kconfig — Architecture Kconfig for sim
#
# Place at: arch/sim/Kconfig
#
# Defines the SIM architecture and its options.

config ARCH_SIM
	bool
	select HAS_DTS
	select HAS_KERNEL
	help
	  Universal RTOS Native Simulator architecture.
	  Uses stackful coroutines (corosensei) for thread switching and
	  virtual time for deterministic scheduling.

config ARCH
	default "sim" if ARCH_SIM

config SIMULATION_HOST_MODE
	bool "Build for host simulation mode"
	default y
	help
	  When enabled, Zephyr is compiled as a host-native library
	  linked into the Rust simulator runner.  Thread switching,
	  interrupt handling, and time keeping are delegated to the
	  Rust fiber runtime via the sim ABI.
```

## crates/sim-zephyr-port/zephyr_integration/boards/sim/Kconfig
```kconfig
# Kconfig — Board Kconfig for sim
#
# Place at: boards/sim/Kconfig
#
# Defines the board selection option and any board-specific
# user-configurable settings.

config BOARD_SIM
	bool "Universal RTOS Native Simulator"
	depends on ARCH="sim"
	select SOC_SIM
	help
	  Virtual board target for the Universal RTOS Native Simulator.
	  This board runs Zephyr applications on the Rust-managed fiber
	  runtime using corosensei stackful coroutines.  No hardware
	  peripherals are emulated — virtual UART, timer, and interrupt
	  controller are provided by the sim-devices crate.

	  Build with:
	    west build -b sim

	  The resulting libzephyr.a is linked into the sim-runner binary
	  via:
	    cargo build --features zephyr
```

## ports/zephyr/module/Kconfig
```kconfig
# Zephyr drivers for costar devices (see include/costar.h).

config COSTAR_THREAD_INFO
	bool "Tell costar each thread's stack size"
	default y
	depends on ARCH_POSIX
	select THREAD_STACK_INFO
	help
	  costar's runner asks for each thread's declared stack size when the
	  thread starts, so that costar can check the thread stays within it.

config COSTAR_UART
	bool "UART on a costar channel device"
	default y
	depends on DT_HAS_COSTAR_UART_ENABLED
	depends on SERIAL
	select SERIAL_HAS_DRIVER
	select SERIAL_SUPPORT_INTERRUPT

config COSTAR_ENTROPY
	bool "Deterministic entropy, seeded from a costar registers device"
	default y
	depends on DT_HAS_COSTAR_ENTROPY_ENABLED
	depends on ENTROPY_GENERATOR
	select ENTROPY_HAS_DRIVER

config COSTAR_GPIO
	bool "GPIO on a costar registers device"
	default y
	depends on DT_HAS_COSTAR_GPIO_ENABLED
	depends on GPIO

config COSTAR_CAN
	bool "CAN controller on a costar channel device"
	default y
	depends on DT_HAS_COSTAR_CAN_ENABLED
	depends on CAN

config COSTAR_CAN_MAX_FILTERS
	int "Receive filters per costar CAN controller"
	default 16
	depends on COSTAR_CAN

config COSTAR_WDT
	bool "Watchdog on a costar watchdog device"
	default y
	depends on DT_HAS_COSTAR_WDT_ENABLED
	depends on WATCHDOG
	select HAS_WDT_NO_CALLBACKS

config COSTAR_I2C
	bool "I2C controller on a costar channel device"
	default y
	depends on DT_HAS_COSTAR_I2C_ENABLED
	depends on I2C
	select I2C_TRANSFER_TIMEOUT_SUPPORTED

config COSTAR_I2C_FRAME_SIZE
	int "Largest request or reply frame of a costar I2C transfer, in bytes"
	default 4096
	depends on COSTAR_I2C
	help
	  Each controller has one buffer of this size for a transfer's request
	  and then its reply: 3 bytes, plus 3 per message and a write's data;
	  4 bytes, plus the data read.  Larger transfers fail with -EINVAL.

config COSTAR_SPI
	bool "SPI controller on a costar channel device"
	default y
	depends on DT_HAS_COSTAR_SPI_ENABLED
	depends on SPI

config COSTAR_SPI_FRAME_SIZE
	int "Largest request or reply frame of a costar SPI controller, in bytes"
	default 4096
	depends on COSTAR_SPI
	help
	  Each controller has one buffer of this size for a request and then its
	  reply.  Longer transfers are split into frames of this size, within
	  one transaction.

config COSTAR_FLASH
	bool "Flash on a costar memory device"
	default y
	depends on DT_HAS_COSTAR_FLASH_ENABLED
	depends on FLASH
	select FLASH_HAS_DRIVER_ENABLED
	select FLASH_HAS_PAGE_LAYOUT

config COSTAR_ADC
	bool "ADC on a costar registers device"
	default y
	depends on DT_HAS_COSTAR_ADC_ENABLED
	depends on ADC

config COSTAR_PWM
	bool "PWM on a costar registers device"
	default y
	depends on DT_HAS_COSTAR_PWM_ENABLED
	depends on PWM

config COSTAR_EEPROM
	bool "EEPROM on a costar memory device"
	default y
	depends on DT_HAS_COSTAR_EEPROM_ENABLED
	depends on EEPROM

config COSTAR_ETH
	bool "Ethernet on a costar channel device"
	default y
	depends on DT_HAS_COSTAR_ETH_ENABLED
	depends on NET_L2_ETHERNET

config COSTAR_ETH_RX_THREAD_STACK_SIZE
	int "Stack size of a costar Ethernet device's RX thread"
	default NET_RX_STACK_SIZE
	depends on COSTAR_ETH
	help
	  The RX thread hands received packets to the network stack, which
	  may process them in it (with CONFIG_NET_TC_RX_COUNT=0, as its own RX
	  thread would), hence the same default size.

config COSTAR_ETH_RX_THREAD_PRIORITY
	int "Priority of a costar Ethernet device's RX thread (cooperative)"
	default 2
	depends on COSTAR_ETH
```

## ports/zephyr/module/dts/bindings/costar,adc.yaml
```yaml
description: |
  An ADC on a costar registers device.  Register n holds channel n's raw
  sample, set by the host or a plant; a conversion takes no virtual time.
  Channels are child nodes named "channel", as for any Zephyr ADC.

compatible: "costar,adc"

include: adc-controller.yaml

properties:
  costar-device:
    type: string
    required: true
    description: Name of the registers device on the costar board.
  nchannels:
    type: int
    default: 8
    description: Number of channels (registers 0 to nchannels - 1), at most 32.
  ref-internal-mv:
    type: int
    default: 3300
    description: The internal reference's voltage, in millivolts (adc_ref_internal()).
  "#io-channel-cells":
    const: 1

io-channel-cells:
  - input
```

## ports/zephyr/module/dts/bindings/costar,can.yaml
```yaml
description: |
  A CAN controller on a costar channel device.  Each CAN frame is one channel
  frame: a big-endian identifier with flags in its top bits (0x80000000
  extended, 0x40000000 remote, 0x20000000 FD), the DLC (plus 0x80 for bit rate
  switch), then the data.

compatible: "costar,can"

include: can-fd-controller.yaml

properties:
  costar-device:
    type: string
    required: true
    description: Name of the channel device on the costar board.
  irq:
    type: int
    required: true
    description: The device's IRQ line on the costar board (3..31 on native_sim).
```

## ports/zephyr/module/dts/bindings/costar,eeprom.yaml
```yaml
description: |
  EEPROM on a costar memory device.  The memory's size is the EEPROM's; any
  byte can be written, without erasing.  If size is given, it must be the
  memory's.

compatible: "costar,eeprom"

include: eeprom-base.yaml

properties:
  costar-device:
    type: string
    required: true
    description: Name of the memory device on the costar board.
```

## ports/zephyr/module/dts/bindings/costar,entropy.yaml
```yaml
description: |
  Deterministic entropy: a pseudo-random generator, seeded from the seed
  property XORed with registers 0 (low 32 bits) and 1 (high 32 bits) of a
  costar registers device, if the board has one.  The costar shield declares
  one and makes it zephyr,entropy.

compatible: "costar,entropy"

include: base.yaml

properties:
  costar-device:
    type: string
    default: "entropy"
    description: Name of the registers device that seeds the generator.
  seed:
    type: int
    default: 0
    description: Seed used as is when the board has no such device.
```

## ports/zephyr/module/dts/bindings/costar,eth.yaml
```yaml
description: |
  Ethernet on a costar channel device.  Each channel frame is one Ethernet
  frame, without preamble, FCS or padding.  Without a MAC address in
  devicetree, the address is random (deterministic with costar,entropy).

compatible: "costar,eth"

include: ethernet-controller.yaml

properties:
  costar-device:
    type: string
    required: true
    description: Name of the channel device on the costar board.
  irq:
    type: int
    required: true
    description: The device's IRQ line on the costar board (3..31 on native_sim).
```

## ports/zephyr/module/dts/bindings/costar,flash.yaml
```yaml
description: |
  Flash on a costar memory device.  The device's size is the flash size;
  erased bytes read 0xFF.

compatible: "costar,flash"

include: base.yaml

properties:
  costar-device:
    type: string
    required: true
    description: Name of the memory device on the costar board.
  erase-block-size:
    type: int
    default: 4096
  write-block-size:
    type: int
    default: 1
```

## ports/zephyr/module/dts/bindings/costar,gpio.yaml
```yaml
description: |
  A GPIO port on a costar registers device.  Register 0 holds the input
  levels (one bit per pin), set by the host or a plant; the driver writes the
  output pins' levels to register 1.  Input pins can have edge-triggered
  interrupts when the device has an IRQ.

compatible: "costar,gpio"

include: [base.yaml, gpio-controller.yaml]

properties:
  costar-device:
    type: string
    required: true
    description: Name of the registers device on the costar board.
  irq:
    type: int
    description: The device's IRQ line on the costar board (3..31 on native_sim). Omit for no interrupts.
  "#gpio-cells":
    const: 2

gpio-cells:
  - pin
  - flags
```

## ports/zephyr/module/dts/bindings/costar,i2c.yaml
```yaml
description: |
  An I2C controller on a costar channel device.  Each transfer is one request
  frame, answered by one reply frame (include/costar_i2c.h); on the host,
  scenario device models (i2c-registers, i2c-eeprom) answer for the parts.
  The costar shield makes native_sim's i2c0 one, on the channel "i2c0" with
  IRQ 12.

compatible: "costar,i2c"

include: i2c-controller.yaml

properties:
  costar-device:
    type: string
    required: true
    description: Name of the channel device on the costar board.
  irq:
    type: int
    required: true
    description: The device's IRQ line on the costar board (3..31 on native_sim).
```

## ports/zephyr/module/dts/bindings/costar,pwm.yaml
```yaml
description: |
  PWM on a costar registers device.  Channel c's period and pulse, in
  cycles, are registers 3c and 3c + 1; register 3c + 2 holds its flags (1:
  inverted polarity).  The driver writes them when they change.

compatible: "costar,pwm"

include: [base.yaml, pwm-controller.yaml]

properties:
  costar-device:
    type: string
    required: true
    description: Name of the registers device on the costar board.
  channels:
    default: 8
  clock-frequency:
    type: int
    default: 1000000000
    description: Cycles per second; the default makes cycles nanoseconds.
  "#pwm-cells":
    const: 3

pwm-cells:
  - channel
  - period
  - flags
```

## ports/zephyr/module/dts/bindings/costar,spi.yaml
```yaml
description: |
  A SPI controller on a costar channel device.  Each transceive clocks its
  bytes through the chip select of a device's reg, in request frames each
  answered by a reply frame (include/costar_spi.h); on the host, scenario
  device models (spi-nor) answer for the devices.  Chip selects are native:
  cs-gpios isn't supported.  The costar shield makes native_sim's spi0 one,
  on the channel "spi0" with IRQ 13.

compatible: "costar,spi"

include: spi-controller.yaml

properties:
  costar-device:
    type: string
    required: true
    description: Name of the channel device on the costar board.
  irq:
    type: int
    required: true
    description: The device's IRQ line on the costar board (3..31 on native_sim).
```

## ports/zephyr/module/dts/bindings/costar,uart.yaml
```yaml
description: |
  A UART on a costar channel device.  Frames arriving on the channel are read
  byte by byte; each write is sent as one frame (use a byte-stream wire for
  UART timing).

compatible: "costar,uart"

include: uart-controller.yaml

properties:
  costar-device:
    type: string
    required: true
    description: Name of the channel device on the costar board.
  irq:
    type: int
    required: true
    description: The device's IRQ line on the costar board (3..31 on native_sim).
```

## ports/zephyr/module/dts/bindings/costar,wdt.yaml
```yaml
description: |
  A watchdog on a costar watchdog device: unless it is fed in time, costar
  reboots the machine.  One timeout, in whole milliseconds, with no window
  and no callback.  The costar shield declares one, with the alias watchdog0.

compatible: "costar,wdt"

include: base.yaml

properties:
  costar-device:
    type: string
    default: "wdt"
    description: Name of the watchdog device in the scenario.
```
