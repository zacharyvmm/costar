## CMakeLists.txt
```
cmake_minimum_required(VERSION 3.20.0)
find_package(Zephyr REQUIRED HINTS $ENV{ZEPHYR_BASE})
project(zephyr_shell)

target_sources(app PRIVATE src/main.c)
```

## prj.conf
```kconfig
CONFIG_SYS_CLOCK_TICKS_PER_SEC=1000
CONFIG_BOOT_BANNER=n
CONFIG_SERIAL=y
CONFIG_SHELL=y
CONFIG_KERNEL_SHELL=y
# Plain text on the console: no colours.
CONFIG_SHELL_VT100_COLORS=n
```

## app.overlay
```dts
/* The Zephyr shell on a costar UART (ports/zephyr/module). */
/ {
	chosen {
		zephyr,shell-uart = &costar_uart;
	};

	costar_uart: costar-uart {
		compatible = "costar,uart";
		costar-device = "uart";
		irq = <5>;
	};
};
```

## src/main.c
```c
/*
 * The Zephyr shell on a costar UART: an ordinary Zephyr application whose
 * shell (see prj.conf and app.overlay) runs on its own thread.  It adds one
 * command of its own, `costar hello`.
 */
#include <zephyr/kernel.h>
#include <zephyr/shell/shell.h>

static int cmd_hello(const struct shell *sh, size_t argc, char **argv)
{
	shell_print(sh, "hello from %s at %u ms", argc > 1 ? argv[1] : "costar", k_uptime_get_32());
	return 0;
}

SHELL_STATIC_SUBCMD_SET_CREATE(costar_commands,
			       SHELL_CMD_ARG(hello, NULL, "Say hello: hello [name]", cmd_hello, 1, 1),
			       SHELL_SUBCMD_SET_END);
SHELL_CMD_REGISTER(costar, &costar_commands, "costar test commands", NULL);

int main(void)
{
	return 0;
}
```
